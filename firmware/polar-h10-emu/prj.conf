## CMakeLists.txt
```
# Polar H10 BLE Emulator Dongle
# nRF Connect SDK / Zephyr RTOS
cmake_minimum_required(VERSION 3.20.0)

find_package(Zephyr REQUIRED HINTS $ENV{ZEPHYR_BASE})
project(polar_h10_emu)

# ── Sources ───────────────────────────────────────────────────────────
target_sources(app PRIVATE
  src/main.c
  src/gatt_service.c
  src/measurements.c
  src/usb_console.c
  src/scenarios.c
)
```

## prj.conf
```kconfig
# ── BLE ─────────────────────────────────────────────────────────────
CONFIG_BT=y
CONFIG_BT_PERIPHERAL=y
CONFIG_BT_DEVICE_NAME="Polar H10 XXXX"
CONFIG_BT_MAX_CONN=1

# Enable bondable Just Works pairing. The dongle has no display, keyboard, or
# confirmation button, so requiring MITM or application pairing acceptance
# makes BlueZ connect and then fail authentication every time.
CONFIG_BT_SMP=y
CONFIG_BT_BONDABLE=y
CONFIG_BT_MAX_PAIRED=1
CONFIG_BT_SMP_APP_PAIRING_ACCEPT=n
CONFIG_BT_SMP_SC_PAIR_ONLY=n
CONFIG_BT_SMP_ENFORCE_MITM=n

# ── USB console ─────────────────────────────────────────────────────
CONFIG_UART_INTERRUPT_DRIVEN=y
CONFIG_UART_LINE_CTRL=y

# ── Logging ─────────────────────────────────────────────────────────
CONFIG_LOG=y
CONFIG_LOG_MODE_DEFERRED=y
CONFIG_LOG_MODE_OVERFLOW=y
CONFIG_LOG_DEFAULT_LEVEL=3
```

## src/main.c
```c
#include <zephyr/kernel.h>
#include <zephyr/logging/log.h>
#include <zephyr/bluetooth/bluetooth.h>
#include <zephyr/bluetooth/uuid.h>
#include <zephyr/bluetooth/conn.h>

#include "gatt_service.h"
#include "measurements.h"
#include "usb_console.h"

LOG_MODULE_REGISTER(main, LOG_LEVEL_DBG);

static const struct bt_data ad[] = {
    BT_DATA_BYTES(BT_DATA_FLAGS, (BT_LE_AD_GENERAL | BT_LE_AD_NO_BREDR)),
    BT_DATA_BYTES(BT_DATA_UUID16_ALL, 0x0D, 0x18) /* 0x180D (Heart Rate Service) in little-endian */
};

static const struct bt_data sd[] = {
    BT_DATA(BT_DATA_NAME_COMPLETE, "Polar H10 XXXX", 14),
};

static void connected(struct bt_conn *conn, uint8_t err) {
    if (err) {
        LOG_ERR("Connection failed (err 0x%02x)", err);
    } else {
        LOG_INF("Connected");
        polar_console_print("[BLE] Connected");
    }
}

static void adv_start(void)
{
    int err = bt_le_adv_start(BT_LE_ADV_CONN_FAST_2, ad, ARRAY_SIZE(ad), sd, ARRAY_SIZE(sd));
    if (err && err != -EALREADY) {
        LOG_ERR("advertising start failed (%d)", err);
    } else {
        LOG_INF("advertising as \"%s\"", CONFIG_BT_DEVICE_NAME);
    }
}

static void adv_work_handler(struct k_work *work)
{
    ARG_UNUSED(work);
    adv_start();
}
static K_WORK_DEFINE(adv_work, adv_work_handler);

static void disconnected(struct bt_conn *conn, uint8_t reason) {
    LOG_INF("Disconnected (reason 0x%02x)", reason);
    polar_console_print("[BLE] Disconnected");

    k_work_submit(&adv_work);
}

BT_CONN_CB_DEFINE(conn_callbacks) = {
    .connected = connected,
    .disconnected = disconnected,
};

int main(void) {
    int err;

    k_sleep(K_SECONDS(2));
    polar_console_init();

    LOG_INF("Starting Polar H10 Emulator");

    err = bt_enable(NULL);
    if (err) {
        LOG_ERR("Bluetooth init failed (err %d)", err);
        return 0;
    }
    LOG_INF("Bluetooth initialized");

    measurements_init();
    gatt_service_init();

    adv_start();
    polar_console_print("[BLE] Advertising started");

    measurements_start();

    return 0;
}
```

## src/gatt_service.c
```c
#include "gatt_service.h"

#include <zephyr/bluetooth/bluetooth.h>
#include <zephyr/bluetooth/uuid.h>
#include <zephyr/bluetooth/gatt.h>
#include <zephyr/logging/log.h>

LOG_MODULE_REGISTER(gatt, LOG_LEVEL_DBG);

static bool notify_enabled = false;

static void hrm_ccc_cfg_changed(const struct bt_gatt_attr *attr, uint16_t value) {
    notify_enabled = (value == BT_GATT_CCC_NOTIFY);
    LOG_INF("Heart Rate Measurement Notifications: %s", notify_enabled ? "Enabled" : "Disabled");
}

BT_GATT_SERVICE_DEFINE(hrs_svc,
    BT_GATT_PRIMARY_SERVICE(BT_UUID_HRS),
    BT_GATT_CHARACTERISTIC(BT_UUID_HRS_MEASUREMENT,
                           BT_GATT_CHRC_NOTIFY,
                           BT_GATT_PERM_NONE,
                           NULL, NULL, NULL),
    BT_GATT_CCC(hrm_ccc_cfg_changed,
                BT_GATT_PERM_READ | BT_GATT_PERM_WRITE),
    // Optional: Body Sensor Location (0 = Other, 1 = Chest, 2 = Wrist, etc.)
    BT_GATT_CHARACTERISTIC(BT_UUID_HRS_BODY_SENSOR,
                           BT_GATT_CHRC_READ,
                           BT_GATT_PERM_READ,
                           NULL, NULL, NULL) // Hardcoding to Chest (1) could be done here if needed
);

void gatt_service_init(void) {
    LOG_INF("Polar H10 GATT service registered");
}

bool gatt_is_subscribed(void) {
    return notify_enabled;
}

void gatt_notify_hrm(const uint8_t *data, uint16_t len) {
    if (!notify_enabled) {
        return;
    }
    bt_gatt_notify(NULL, &hrs_svc.attrs[1], data, len);
}
```

## src/gatt_service.h
```c
#pragma once

#include <stdint.h>
#include <stdbool.h>

void gatt_service_init(void);

// Notifies the connected client with a Heart Rate Measurement frame.
// data: pointer to the frame bytes
// len:  number of bytes in the frame
void gatt_notify_hrm(const uint8_t *data, uint16_t len);

// Returns true if a client is connected and has enabled notifications
// on the Heart Rate Measurement characteristic.
bool gatt_is_subscribed(void);
```

## src/measurements.c
```c
#include "measurements.h"
#include "scenarios.h"
#include "gatt_service.h"
#include <zephyr/kernel.h>
#include <zephyr/random/random.h>
#include <zephyr/logging/log.h>
#include <stdlib.h>

LOG_MODULE_REGISTER(measurements, LOG_LEVEL_DBG);

static struct k_timer meas_timer;
static struct k_work meas_work;

static uint32_t residual_ms = 0;
static uint16_t current_hr = 60;

static void meas_work_handler(struct k_work *work) {
    if (!gatt_is_subscribed()) {
        return;
    }

    const struct polar_scenario *scen = polar_scenario_active();

    // Smoothly drift HR towards bounds
    int32_t hr_step = (sys_rand32_get() % 3) - 1; // -1, 0, or 1
    current_hr = (uint16_t)((int32_t)current_hr + hr_step);

    if (current_hr < scen->hr_min) current_hr = scen->hr_min;
    if (current_hr > scen->hr_max) current_hr = scen->hr_max;
    if (current_hr == 0) current_hr = 60; // Failsafe

    uint32_t rr_target_ms = 60000 / current_hr;
    uint32_t ms_passed = 1000 + residual_ms;

    uint8_t payload[20];
    payload[0] = 0x10; // Flags: RR present, 8-bit HR format
    payload[1] = (uint8_t)current_hr;

    int rr_count = 0;
    int offset = 2;

    while (ms_passed >= rr_target_ms && rr_count < 8 && offset < 18) {
        // Add random jitter
        int32_t jitter = 0;
        if (scen->hrv_jitter_ms > 0) {
            jitter = (sys_rand32_get() % (scen->hrv_jitter_ms * 2 + 1)) - scen->hrv_jitter_ms;
        }

        uint32_t actual_rr_ms = rr_target_ms;
        if ((int32_t)actual_rr_ms + jitter > 0) {
            actual_rr_ms += jitter;
        } else {
            actual_rr_ms = 1;
        }

        // Convert ms to 1/1024s (ms * 1024 / 1000)
        uint16_t rr_1024 = (uint16_t)((actual_rr_ms * 1024) / 1000);

        payload[offset++] = (uint8_t)(rr_1024 & 0xFF);
        payload[offset++] = (uint8_t)(rr_1024 >> 8);

        // We only consume the nominal rr_target_ms so average HR remains correct,
        // even though individual beats are jittered.
        if (ms_passed > rr_target_ms) {
            ms_passed -= rr_target_ms;
        } else {
            ms_passed = 0;
        }
        rr_count++;
    }

    residual_ms = ms_passed;
    gatt_notify_hrm(payload, offset);
}

static void meas_timer_handler(struct k_timer *dummy) {
    k_work_submit(&meas_work);
}

void measurements_init(void) {
    k_work_init(&meas_work, meas_work_handler);
    k_timer_init(&meas_timer, meas_timer_handler, NULL);

    // Initialize default scenario
    polar_scenario_activate(polar_scenario_get(SCENARIO_NORMAL));
}

void measurements_start(void) {
    residual_ms = 0;
    current_hr = polar_scenario_active()->hr_min;
    k_timer_start(&meas_timer, K_SECONDS(1), K_SECONDS(1));
    LOG_INF("Measurements started");
}

void measurements_stop(void) {
    k_timer_stop(&meas_timer);
    LOG_INF("Measurements stopped");
}
```

## src/measurements.h
```c
#pragma once

#include <stdint.h>

void measurements_init(void);

// Begin the 1Hz heartbeat timer that calculates and sends RR intervals
void measurements_start(void);

// Stop the timer
void measurements_stop(void);
```

## src/scenarios.c
```c
#include "scenarios.h"
#include <string.h>
#include <strings.h>

static struct polar_scenario scenarios[SCENARIO_COUNT] = {
    [SCENARIO_NORMAL] = {
        .name = "normal",
        .id = SCENARIO_NORMAL,
        .hr_min = 60,
        .hr_max = 80,
        .hrv_jitter_ms = 40,
    },
    [SCENARIO_SLEEP] = {
        .name = "sleep",
        .id = SCENARIO_SLEEP,
        .hr_min = 45,
        .hr_max = 55,
        .hrv_jitter_ms = 80, // Higher HRV at rest
    },
    [SCENARIO_EXERCISE] = {
        .name = "exercise",
        .id = SCENARIO_EXERCISE,
        .hr_min = 120,
        .hr_max = 160,
        .hrv_jitter_ms = 10, // Very low HRV under strain
    },
    [SCENARIO_AFIB] = {
        .name = "afib",
        .id = SCENARIO_AFIB,
        .hr_min = 80,
        .hr_max = 140,
        .hrv_jitter_ms = 250, // Massive erratic RR intervals
    },
};

static struct polar_scenario active_scenario;

const struct polar_scenario *polar_scenario_get(enum polar_scenario_id id) {
    if (id >= SCENARIO_COUNT) return NULL;
    return &scenarios[id];
}

const struct polar_scenario *polar_scenario_by_name(const char *name) {
    for (int i = 0; i < SCENARIO_COUNT; i++) {
        if (strcmp(scenarios[i].name, name) == 0) {
            return &scenarios[i];
        }
    }
    return NULL;
}

const struct polar_scenario *polar_scenario_active(void) {
    return &active_scenario;
}

void polar_scenario_activate(const struct polar_scenario *s) {
    if (!s) return;
    memcpy(&active_scenario, s, sizeof(struct polar_scenario));
}

void polar_scenario_list_all(void (*print_fn)(const char *line)) {
    for (int i = 0; i < SCENARIO_COUNT; i++) {
        print_fn(scenarios[i].name);
    }
}

void polar_scenario_set_hr(uint16_t min_bpm, uint16_t max_bpm) {
    active_scenario.hr_min = min_bpm;
    active_scenario.hr_max = max_bpm;
}

void polar_scenario_set_jitter(int32_t jitter_ms) {
    active_scenario.hrv_jitter_ms = jitter_ms;
}
```

## src/scenarios.h
```c
#pragma once

#include <stdint.h>
#include <stdbool.h>

#ifdef __cplusplus
extern "C" {
#endif

enum polar_scenario_id {
    SCENARIO_NORMAL = 0,
    SCENARIO_SLEEP,
    SCENARIO_EXERCISE,
    SCENARIO_AFIB,
    SCENARIO_COUNT
};

struct polar_scenario {
    const char *name;
    enum polar_scenario_id id;

    uint16_t hr_min;
    uint16_t hr_max;

    int32_t hrv_jitter_ms; // Amplitude of random jitter added to RR interval
};

const struct polar_scenario *polar_scenario_get(enum polar_scenario_id id);
const struct polar_scenario *polar_scenario_by_name(const char *name);
const struct polar_scenario *polar_scenario_active(void);
void polar_scenario_activate(const struct polar_scenario *s);
void polar_scenario_list_all(void (*print_fn)(const char *line));

// Modify currently active scenario properties (used by serial console)
void polar_scenario_set_hr(uint16_t min_bpm, uint16_t max_bpm);
void polar_scenario_set_jitter(int32_t jitter_ms);

#ifdef __cplusplus
}
#endif
```

## src/usb_console.c
```c
#include "usb_console.h"
#include "scenarios.h"

#include <zephyr/kernel.h>
#include <zephyr/device.h>
#include <zephyr/drivers/uart.h>
#include <zephyr/sys/ring_buffer.h>
#include <zephyr/logging/log.h>

#include <stdio.h>
#include <stdlib.h>
#include <string.h>
#include <ctype.h>

LOG_MODULE_REGISTER(usb_console, LOG_LEVEL_DBG);

#define CONSOLE_THREAD_STACK 1024
#define CONSOLE_THREAD_PRIO  7
#define CONSOLE_RINGBUF_SIZE 512
#define CONSOLE_LINE_MAX     128

static const struct device *uart_dev;

RING_BUF_DECLARE(console_rb, CONSOLE_RINGBUF_SIZE);
static struct k_thread console_thread_data;
static K_THREAD_STACK_DEFINE(console_thread_stack, CONSOLE_THREAD_STACK);
static struct k_mutex print_mutex;

/* ── Output ──────────────────────────────────────────────────────────── */

void polar_console_print(const char *line) {
    if (!uart_dev) return;

    k_mutex_lock(&print_mutex, K_FOREVER);
    for (size_t i = 0; line[i]; i++) {
        uart_poll_out(uart_dev, (unsigned char)line[i]);
    }
    uart_poll_out(uart_dev, '\r');
    uart_poll_out(uart_dev, '\n');
    k_mutex_unlock(&print_mutex);
}

void polar_console_printf(const char *fmt, ...) {
    if (!uart_dev) return;

    char buf[CONSOLE_LINE_MAX];
    va_list args;
    va_start(args, fmt);
    vsnprintf(buf, sizeof(buf), fmt, args);
    va_end(args);

    polar_console_print(buf);
}

void polar_console_print_banner(void) {
    polar_console_print("========================================");
    polar_console_print(" Polar H10 BLE Emulator (nRF52840)");
    polar_console_print(" Type 'help' for commands");
    polar_console_print("========================================");
    polar_console_printf("Active scenario: %s", polar_scenario_active()->name);
}

/* ── Commands ────────────────────────────────────────────────────────── */

static void cmd_help(void) {
    polar_console_print("Commands:");
    polar_console_print("  scenario <name>     Switch scenario (normal, sleep, exercise, afib)");
    polar_console_print("  hr min <v> max <v>  Set min/max HR in BPM");
    polar_console_print("  jitter <ms>         Set HRV jitter in ms");
    polar_console_print("  status              Show current configuration");
}

static void cmd_status(void) {
    const struct polar_scenario *s = polar_scenario_active();
    polar_console_print("--- Status ---");
    polar_console_printf("Scenario: %s", s->name);
    polar_console_printf("HR Range: %u - %u bpm", s->hr_min, s->hr_max);
    polar_console_printf("HRV Jitter: %d ms", s->hrv_jitter_ms);
}

static void handle_line(char *line) {
    if (line[0] == '\0') return;

    char *cmd = strtok(line, " \r\n");
    if (!cmd) return;

    if (strcmp(cmd, "help") == 0) {
        cmd_help();
    } else if (strcmp(cmd, "status") == 0) {
        cmd_status();
    } else if (strcmp(cmd, "scenario") == 0) {
        char *name = strtok(NULL, " \r\n");
        if (!name) {
            polar_console_print("Error: scenario requires a name.");
            return;
        }
        const struct polar_scenario *s = polar_scenario_by_name(name);
        if (!s) {
            polar_console_print("Error: unknown scenario.");
            return;
        }
        polar_scenario_activate(s);
        polar_console_printf("Activated scenario: %s", s->name);
    } else if (strcmp(cmd, "hr") == 0) {
        char *arg = strtok(NULL, " ");
        if (!arg || strcmp(arg, "min") != 0) goto hr_usage;
        arg = strtok(NULL, " ");
        if (!arg) goto hr_usage;
        int min_val = atoi(arg);

        arg = strtok(NULL, " ");
        if (!arg || strcmp(arg, "max") != 0) goto hr_usage;
        arg = strtok(NULL, " ");
        if (!arg) goto hr_usage;
        int max_val = atoi(arg);

        polar_scenario_set_hr((uint16_t)min_val, (uint16_t)max_val);
        polar_console_printf("HR range updated: %d - %d", min_val, max_val);
        return;
hr_usage:
        polar_console_print("Usage: hr min <v> max <v>");
    } else if (strcmp(cmd, "jitter") == 0) {
        char *arg = strtok(NULL, " ");
        if (!arg) {
            polar_console_print("Usage: jitter <ms>");
            return;
        }
        int j = atoi(arg);
        polar_scenario_set_jitter(j);
        polar_console_printf("HRV jitter set to %d ms", j);
    } else {
        polar_console_printf("Unknown command: %s", cmd);
    }
}

/* ── Read Loop ───────────────────────────────────────────────────────── */

static void console_thread(void *p1, void *p2, void *p3) {
    char line[CONSOLE_LINE_MAX];
    size_t pos = 0;

    polar_console_print_banner();
    polar_console_print("> ");

    while (1) {
        uint8_t ch;
        // Wait for a character (in a real blocking manner, depending on how uart_fifo_read handles it)
        // Since UART_INTERRUPT_DRIVEN is set, we can just use uart_poll_in if we want it simple,
        // but Zephyr poll is sometimes non-blocking. Let's do simple poll loop with sleep.
        if (uart_poll_in(uart_dev, &ch) == 0) {
            if (ch == '\r' || ch == '\n') {
                uart_poll_out(uart_dev, '\r');
                uart_poll_out(uart_dev, '\n');
                line[pos] = '\0';
                handle_line(line);
                pos = 0;
                polar_console_print("> ");
            } else if (ch == '\b' || ch == 127) {
                if (pos > 0) {
                    pos--;
                    uart_poll_out(uart_dev, '\b');
                    uart_poll_out(uart_dev, ' ');
                    uart_poll_out(uart_dev, '\b');
                }
            } else if (pos < sizeof(line) - 1) {
                uart_poll_out(uart_dev, ch);
                line[pos++] = (char)ch;
            }
        } else {
            k_msleep(10);
        }
    }
}

int polar_console_init(void) {
    k_mutex_init(&print_mutex);

    uart_dev = DEVICE_DT_GET(DT_CHOSEN(zephyr_console));
    if (!device_is_ready(uart_dev)) {
        LOG_ERR("UART device not ready");
        return -ENODEV;
    }

    LOG_INF("USB console UART ready");

    k_thread_create(&console_thread_data, console_thread_stack,
                    K_THREAD_STACK_SIZEOF(console_thread_stack),
                    console_thread, NULL, NULL, NULL,
                    CONSOLE_THREAD_PRIO, 0, K_NO_WAIT);

    return 0;
}
```

## src/usb_console.h
```c
#pragma once

#include <stdint.h>
#include <stdbool.h>

#ifdef __cplusplus
extern "C" {
#endif

int polar_console_init(void);
void polar_console_print(const char *line);
void polar_console_printf(const char *fmt, ...);
void polar_console_print_banner(void);

#ifdef __cplusplus
}
#endif
```
